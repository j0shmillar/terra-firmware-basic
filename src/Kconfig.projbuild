## src/Kconfig.projbuild
```kconfig
menu "ESP32 I2S Mic Test Configuration"
    config ESP_WIFI_SSID
        string "WiFi SSID"
        default "CommunityFibre10Gb_A0931"
        help
            SSID (network name) for the example to connect to.

    config ESP_WIFI_PASSWORD
        string "WiFi Password"
        default "iz100s30uv"
        help
            WiFi password (WPA or WPA2) for the example to use.

    config ESP_MAXIMUM_RETRY
        int "Maximum retry"
        default 5
        help
            Set the Maximum retry to avoid station reconnecting to the AP unlimited when the AP is really inexistent.

    config ESP_HTTP_SERVER_HOST
        string "HTTP server host"
        default "161.51.52.196"
        help
            The hostname (IP address) of HTTP server to send audio samples

    config ESP_HTTP_SERVER_PORT
        int "HTTP server TCP/IP port"
        default 5003
        help
            The port number of HTTP server to send audio samples

    config ESP_HTTP_SERVER_PATH
        string "HTTP server target path"
        default "/samples"
        help
            The target path to send audio sample at HTTP server
endmenu
```
